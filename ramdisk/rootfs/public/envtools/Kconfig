## ramdisk/rootfs/public/envtools/Kconfig
```kconfig
config TARGET_PACKAGE_ENVTOOLS
	bool "Target package envtools"
	default n
	help
	envtools version: u-boot
	source code:u-boot/tools/env
	build by "make envtools"
```
